## config/boards/shields/rae_dux/Kconfig.defconfig
```kconfig
# Copyright (c) 2022 The ZMK Contributors
# SPDX-License-Identifier: MIT

if SHIELD_VEE_BOARD_LEFT

config ZMK_KEYBOARD_NAME
	default "vee_board"

config ZMK_SPLIT_BLE_ROLE_CENTRAL
	default y

endif

if SHIELD_VEE_BOARD_LEFT || SHIELD_VEE_BOARD_RIGHT

config ZMK_SPLIT
	default y

endif
```

## config/boards/shields/rae_dux/Kconfig.shield
```kconfig
# Copyright (c) 2022 The ZMK Contributors
# SPDX-License-Identifier: MIT

config SHIELD_VEE_BOARD_LEFT
	def_bool $(shields_list_contains,vee_board_left)

config SHIELD_VEE_BOARD_RIGHT
	def_bool $(shields_list_contains,vee_board_right)
```
